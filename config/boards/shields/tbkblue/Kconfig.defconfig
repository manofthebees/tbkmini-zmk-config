## config/boards/shields/tbkblue/Kconfig.defconfig
```kconfig
if SHIELD_TBKBLU_LEFT
 
config ZMK_KEYBOARD_NAME
    default "TBKblu"
 
config ZMK_SPLIT_ROLE_CENTRAL
    default y
 
endif
 
if SHIELD_TBKBLU_LEFT || SHIELD_TBKBLU_RIGHT
 
config ZMK_SPLIT
    default y
 
endif
```

## config/boards/shields/tbkblue/Kconfig.shield
```kconfig
config SHIELD_TBKBLU_LEFT
    def_bool $(shields_list_contains,tbkblu_left)
    select SHIELD_TBKBLU

config SHIELD_TBKBLU_RIGHT
    def_bool $(shields_list_contains,tbkblu_right)
    select SHIELD_TBKBLU
```
